## config/west.yml
```yaml
# manifest:
#   remotes:
#     - name: alxcrt
#       url-base: https://github.com/alxcrt
#   projects:
#     - name: zmk
#       remote: alxcrt
#       revision: main
#       import: app/west.yml
#   self:
#     path: config


manifest:
  remotes:
    - name: zmkfirmware
      url-base: https://github.com/zmkfirmware
    - name: carrefinho                            # <--- add this
      url-base: https://github.com/carrefinho     # <--- and this
  projects:
    - name: zmk
      remote: zmkfirmware
      revision: main
      import: app/west.yml
    - name: prospector-zmk-module                 # <--- and these
      remote: carrefinho                          # <---
      revision: main                              # <---
  self:
    path: config
```
